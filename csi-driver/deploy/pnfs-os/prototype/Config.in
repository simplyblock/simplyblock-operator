## csi-driver/deploy/pnfs-os/prototype/Config.in
```kconfig
source "$BR2_EXTERNAL_VELAOS_PATH/package/pgvector/Config.in"
source "$BR2_EXTERNAL_VELAOS_PATH/package/pgexporter/Config.in"
source "$BR2_EXTERNAL_VELAOS_PATH/package/su-exec/Config.in"
source "$BR2_EXTERNAL_VELAOS_PATH/package/vm-monitor/Config.in"
source "$BR2_EXTERNAL_VELAOS_PATH/package/neonvmd/Config.in"
source "$BR2_EXTERNAL_VELAOS_PATH/package/pgbouncer/Config.in"
source "$BR2_EXTERNAL_VELAOS_PATH/package/vector/Config.in"
source "$BR2_EXTERNAL_VELAOS_PATH/package/sb-storage/Config.in"
source "$BR2_EXTERNAL_VELAOS_PATH/package/pg-meta/Config.in"
source "$BR2_EXTERNAL_VELAOS_PATH/package/pgrouting/Config.in"
source "$BR2_EXTERNAL_VELAOS_PATH/package/h3/Config.in"
source "$BR2_EXTERNAL_VELAOS_PATH/package/postgresql-unit/Config.in"
source "$BR2_EXTERNAL_VELAOS_PATH/package/hypopg/Config.in"
source "$BR2_EXTERNAL_VELAOS_PATH/package/online-advisor/Config.in"
source "$BR2_EXTERNAL_VELAOS_PATH/package/hashids/Config.in"
source "$BR2_EXTERNAL_VELAOS_PATH/package/rum/Config.in"
source "$BR2_EXTERNAL_VELAOS_PATH/package/pgtap/Config.in"
source "$BR2_EXTERNAL_VELAOS_PATH/package/ip4r/Config.in"
source "$BR2_EXTERNAL_VELAOS_PATH/package/prefix/Config.in"
source "$BR2_EXTERNAL_VELAOS_PATH/package/postgresql-hll/Config.in"
source "$BR2_EXTERNAL_VELAOS_PATH/package/pg-ivm/Config.in"
source "$BR2_EXTERNAL_VELAOS_PATH/package/pg-cron/Config.in"
source "$BR2_EXTERNAL_VELAOS_PATH/package/plpgsql-check/Config.in"
source "$BR2_EXTERNAL_VELAOS_PATH/package/pg-hint-plan/Config.in"
source "$BR2_EXTERNAL_VELAOS_PATH/package/pg-uuidv7/Config.in"
source "$BR2_EXTERNAL_VELAOS_PATH/package/pg-net/Config.in"
source "$BR2_EXTERNAL_VELAOS_PATH/package/pg-jwt/Config.in"
source "$BR2_EXTERNAL_VELAOS_PATH/package/pg-repack/Config.in"
source "$BR2_EXTERNAL_VELAOS_PATH/package/pgsql-http/Config.in"
source "$BR2_EXTERNAL_VELAOS_PATH/package/pgmq/Config.in"
source "$BR2_EXTERNAL_VELAOS_PATH/package/pg-partman/Config.in"
source "$BR2_EXTERNAL_VELAOS_PATH/package/pg-stat-monitor/Config.in"
source "$BR2_EXTERNAL_VELAOS_PATH/package/pg-roaringbitmap/Config.in"
source "$BR2_EXTERNAL_VELAOS_PATH/package/groonga/Config.in"
source "$BR2_EXTERNAL_VELAOS_PATH/package/pgroonga/Config.in"
source "$BR2_EXTERNAL_VELAOS_PATH/package/pg-tiktoken/Config.in"
source "$BR2_EXTERNAL_VELAOS_PATH/package/pg-graphql/Config.in"
source "$BR2_EXTERNAL_VELAOS_PATH/package/pgsodium/Config.in"
source "$BR2_EXTERNAL_VELAOS_PATH/package/pg-audit/Config.in"
source "$BR2_EXTERNAL_VELAOS_PATH/package/pg-duckdb/Config.in"
source "$BR2_EXTERNAL_VELAOS_PATH/package/pgauditlogtofile/Config.in"
source "$BR2_EXTERNAL_VELAOS_PATH/package/supabase-vault/Config.in"
source "$BR2_EXTERNAL_VELAOS_PATH/package/wal2json/Config.in"
source "$BR2_EXTERNAL_VELAOS_PATH/package/pg-jsonschema/Config.in"
source "$BR2_EXTERNAL_VELAOS_PATH/package/postgresql-anonymizer/Config.in"
source "$BR2_EXTERNAL_VELAOS_PATH/package/pgx-ulid/Config.in"
source "$BR2_EXTERNAL_VELAOS_PATH/package/postgrest/Config.in"
source "$BR2_EXTERNAL_VELAOS_PATH/package/dbmate/Config.in"
source "$BR2_EXTERNAL_VELAOS_PATH/package/postgres-exporter/Config.in"
source "$BR2_EXTERNAL_VELAOS_PATH/package/pgbouncer-exporter/Config.in"
source "$BR2_EXTERNAL_VELAOS_PATH/package/timescaledb-tune/Config.in"
source "$BR2_EXTERNAL_VELAOS_PATH/package/systemd-exporter/Config.in"
source "$BR2_EXTERNAL_VELAOS_PATH/package/apache-age/Config.in"
```

## csi-driver/deploy/pnfs-os/prototype/package/groonga/Config.in
```kconfig
config BR2_PACKAGE_GROONGA
	bool "groonga"
	help
	  Groonga is a fast full text search engine.
```

## csi-driver/deploy/pnfs-os/prototype/package/ip4r/Config.in
```kconfig
config BR2_PACKAGE_IP4R
	bool "ip4r"
	depends on BR2_PACKAGE_POSTGRESQL
	help
	  IP4R extension for PostgreSQL.
```

## csi-driver/deploy/pnfs-os/prototype/package/neonvmd/Config.in
```kconfig
config BR2_PACKAGE_NEONVMD
	bool "neonvmd"
	depends on BR2_PACKAGE_HOST_GO_TARGET_ARCH_SUPPORTS
	help
	  This is the Neon VM daemon.
```

## csi-driver/deploy/pnfs-os/prototype/package/pg-audit/Config.in
```kconfig
config BR2_PACKAGE_PG_AUDIT
	bool "pg-audit"
	depends on BR2_PACKAGE_POSTGRESQL
	help
	  The PostgreSQL Audit Extension (pgAudit) provides detailed session and/or object audit logging via
	  the standard PostgreSQL logging facility.
```

## csi-driver/deploy/pnfs-os/prototype/package/pg-duckdb/Config.in
```kconfig
config BR2_PACKAGE_PG_DUCKDB
	bool "pg-duckdb"
	depends on BR2_PACKAGE_POSTGRESQL
	help
	  pg_duckdb integrates DuckDB's columnar-vectorized analytics engine into PostgreSQL, enabling
	  high-performance analytics and data-intensive applications.
```

## csi-driver/deploy/pnfs-os/prototype/package/pg-graphql/Config.in
```kconfig
config BR2_PACKAGE_PG_GRAPHQL
	bool "pg-graphql"
	depends on BR2_PACKAGE_HOST_RUSTC_TARGET_ARCH_SUPPORTS
	depends on BR2_PACKAGE_POSTGRESQL
	select BR2_PACKAGE_HOST_RUSTC
	help
	  The pg_graphql extension reflects a GraphQL schema from the existing SQL schema.
```

## csi-driver/deploy/pnfs-os/prototype/package/pg-hint-plan/Config.in
```kconfig
config BR2_PACKAGE_PG_HINT_PLAN
	bool "pg-hint-plan"
	depends on BR2_PACKAGE_POSTGRESQL
	help
	  PG Hint Plan extension for PostgreSQL.
```

## csi-driver/deploy/pnfs-os/prototype/package/pg-jsonschema/Config.in
```kconfig
config BR2_PACKAGE_PG_JSONSCHEMA
	bool "pg-jsonschema"
	depends on BR2_PACKAGE_HOST_RUSTC_TARGET_ARCH_SUPPORTS
	depends on BR2_PACKAGE_POSTGRESQL
	select BR2_PACKAGE_HOST_RUSTC
	help
	  pg_jsonschema is a PostgreSQL extension adding support for JSON schema validation on json and jsonb data types.
```

## csi-driver/deploy/pnfs-os/prototype/package/pg-partman/Config.in
```kconfig
config BR2_PACKAGE_PG_PARTMAN
	bool "pg-partman"
	depends on BR2_PACKAGE_POSTGRESQL
	help
	  pg_partman is an extension to create and manage both time-based and number-based table partition sets.
```

## csi-driver/deploy/pnfs-os/prototype/package/pg-roaringbitmap/Config.in
```kconfig
config BR2_PACKAGE_PG_ROARINGBITMAP
	bool "pg-roaringbitmap"
	depends on BR2_PACKAGE_POSTGRESQL
	help
	  RoaringBitmap extension for PostgreSQL.
```

## csi-driver/deploy/pnfs-os/prototype/package/pgauditlogtofile/Config.in
```kconfig
config BR2_PACKAGE_PGAUDITLOGTOFILE
	bool "pgauditlogtofile"
	depends on BR2_PACKAGE_POSTGRESQL
	help
	  pgAudit Log to File is an addon for pgAudit to redirect audit logs to an independent file extension
	  for PostgreSQL.
```

## csi-driver/deploy/pnfs-os/prototype/package/pgbouncer-exporter/Config.in
```kconfig
config BR2_PACKAGE_PGBOUNCER_EXPORTER
	bool "pgbouncer-exporter"
	depends on BR2_PACKAGE_PGBOUNCER
	help
	  PgBouncer Exporter for exporting PgBouncer metrics to Prometheus.
```

## csi-driver/deploy/pnfs-os/prototype/package/pgbouncer/Config.in
```kconfig
config BR2_PACKAGE_PGBOUNCER
	bool "pgbouncer"
	select BR2_PACKAGE_LIBOPENSSL
	select BR2_PACKAGE_LIBEVENT
	help
	  Lightweight connection pooler for PostgreSQL.
```

## csi-driver/deploy/pnfs-os/prototype/package/pgroonga/Config.in
```kconfig
config BR2_PACKAGE_PGROONGA
	bool "pgroonga"
	depends on BR2_PACKAGE_POSTGRESQL
	select BR2_PACKAGE_GROONGA
	select BR2_PACKAGE_ZSTD
	help
	  PGroonga extension for PostgreSQL.
```

## csi-driver/deploy/pnfs-os/prototype/package/pgsodium/Config.in
```kconfig
config BR2_PACKAGE_PGSODIUM
	bool "pgsodium"
	depends on BR2_PACKAGE_POSTGRESQL
	select BR2_PACKAGE_LIBSODIUM
	select BR2_PACKAGE_LIBSODIUM_FULL
	help
	  pgsodium is an encryption library extension for PostgreSQL using the libsodium library for high level
	  cryptographic algorithms.
```

## csi-driver/deploy/pnfs-os/prototype/package/pgsql-http/Config.in
```kconfig
config BR2_PACKAGE_PGSQL_HTTP
	bool "pgsql-http"
	depends on BR2_PACKAGE_POSTGRESQL
	select BR2_PACKAGE_LIBCURL
	help
	  HTTP client extension for PostgreSQL.
```

## csi-driver/deploy/pnfs-os/prototype/package/pgtap/Config.in
```kconfig
config BR2_PACKAGE_PGTAP
	bool "pgtap"
	depends on BR2_PACKAGE_POSTGRESQL
	help
	  PG Tap extension for PostgreSQL.
```

## csi-driver/deploy/pnfs-os/prototype/package/pgvector/Config.in
```kconfig
config BR2_PACKAGE_PGVECTOR
	bool "pgvector"
	depends on BR2_PACKAGE_POSTGRESQL
	help
	  PgVector extension for PostgreSQL.
```

## csi-driver/deploy/pnfs-os/prototype/package/postgresql-anonymizer/Config.in
```kconfig
config BR2_PACKAGE_POSTGRESQL_ANONYMIZER
	bool "postgresql-anonymizer"
	depends on BR2_PACKAGE_HOST_RUSTC_TARGET_ARCH_SUPPORTS
	depends on BR2_PACKAGE_POSTGRESQL
	select BR2_PACKAGE_HOST_RUSTC
	help
	  PostgreSQL Anonymizer is an extension to mask or replace personally identifiable information (PII) or
	  commercially sensitive data from a Postgres database.
```

## csi-driver/deploy/pnfs-os/prototype/package/postgresql-hll/Config.in
```kconfig
config BR2_PACKAGE_POSTGRESQL_HLL
	bool "postgresql-hll"
	depends on BR2_PACKAGE_POSTGRESQL
	help
	  HyperLogLog extension for PostgreSQL.
```

## csi-driver/deploy/pnfs-os/prototype/package/postgresql-unit/Config.in
```kconfig
config BR2_PACKAGE_POSTGRESQL_UNIT
	bool "postgresql-unit"
	depends on BR2_PACKAGE_POSTGRESQL
	help
	  PostgreSQL SI Unit extension for PostgreSQL.
```

## csi-driver/deploy/pnfs-os/prototype/package/prefix/Config.in
```kconfig
config BR2_PACKAGE_PREFIX
	bool "prefix"
	depends on BR2_PACKAGE_POSTGRESQL
	help
	  Prefix extension for PostgreSQL.
```

## csi-driver/deploy/pnfs-os/prototype/package/systemd-exporter/Config.in
```kconfig
config BR2_PACKAGE_SYSTEMD_EXPORTER
	bool "systemd-exporter"
	help
	  Systemd Exporter for exporting system service status and metrics to Prometheus.
```
