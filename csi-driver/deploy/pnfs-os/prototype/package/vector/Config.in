## csi-driver/deploy/pnfs-os/prototype/package/vector/Config.in
```kconfig
config BR2_PACKAGE_VECTOR
	bool "vector"
	help
	  Vector is a high-performance, end-to-end (agent & aggregator) observability data pipeline that puts
	  you in control of your observability data.
```

## prototype/package/apache-age/Config.in
```kconfig
config BR2_PACKAGE_APACHE_AGE
	bool "apache-age"
	depends on BR2_PACKAGE_POSTGRESQL
	help
	  Apache AGE is a PostgreSQL extension that provides graph database
	  functionality, supporting the openCypher query language.
```

## prototype/package/cargo-pgrx/Config.in
```kconfig
config BR2_PACKAGE_HOST_CARGO_PGRX
	bool "host-cargo-pgrx"
	depends on BR2_PACKAGE_HOST_RUSTC_TARGET_ARCH_SUPPORTS
	select BR2_PACKAGE_HOST_RUSTC
	help
	  Cargo subcommand for managing pgrx-based PostgreSQL extensions.
```

## prototype/package/h3/Config.in
```kconfig
config BR2_PACKAGE_H3
	bool "h3"
	depends on BR2_PACKAGE_POSTGRESQL
	depends on BR2_PACKAGE_POSTGIS
	help
	  H3 Postgis extension for PostgreSQL.
```

## prototype/package/hashids/Config.in
```kconfig
config BR2_PACKAGE_HASHIDS
	bool "hashids"
	depends on BR2_PACKAGE_POSTGRESQL
	help
	  HashIds extension for PostgreSQL.
```

## prototype/package/hypopg/Config.in
```kconfig
config BR2_PACKAGE_HYPOPG
	bool "HypoPG"
	depends on BR2_PACKAGE_POSTGRESQL
	help
	  HypoPG extension for PostgreSQL.
```

## prototype/package/online-advisor/Config.in
```kconfig
config BR2_PACKAGE_ONLINE_ADVISOR
	bool "online-advisor"
	depends on BR2_PACKAGE_POSTGRESQL
	help
	  Online Advisor extension for PostgreSQL.
```

## prototype/package/pg-cron/Config.in
```kconfig
config BR2_PACKAGE_PG_CRON
	bool "pg-cron"
	depends on BR2_PACKAGE_POSTGRESQL
	help
	  Simple cron-based job scheduler extension for PostgreSQL.
```

## prototype/package/pg-ivm/Config.in
```kconfig
config BR2_PACKAGE_PG_IVM
	bool "pg-ivm"
	depends on BR2_PACKAGE_POSTGRESQL
	help
	  Incremental materialized view extension for PostgreSQL.
```

## prototype/package/pg-jwt/Config.in
```kconfig
config BR2_PACKAGE_PG_JWT
	bool "pg-jwt"
	depends on BR2_PACKAGE_POSTGRESQL
	help
	  JWT extension for PostgreSQL.
```

## prototype/package/pg-meta/Config.in
```kconfig
config BR2_PACKAGE_PG_META
	bool "pg-meta"
	select BR2_PACKAGE_NODEJS_SRC
	select BR2_PACKAGE_HOST_NODEJS
	help
	  This is the Supabase-based pg-meta service.
```

## prototype/package/pg-net/Config.in
```kconfig
config BR2_PACKAGE_PG_NET
	bool "pg-net"
	depends on BR2_PACKAGE_POSTGRESQL
	select BR2_PACKAGE_LIBCURL
	help
	  A PostgreSQL extension that enables asynchronous (non-blocking) HTTP/HTTPS requests with SQL.
```

## prototype/package/pg-repack/Config.in
```kconfig
config BR2_PACKAGE_PG_REPACK
	bool "pg-repack"
	depends on BR2_PACKAGE_POSTGRESQL
	help
	  Repack extension for PostgreSQL.
```

## prototype/package/pg-stat-monitor/Config.in
```kconfig
config BR2_PACKAGE_PG_STAT_MONITOR
	bool "pg-stat-monitor"
	depends on BR2_PACKAGE_POSTGRESQL
	depends on BR2_PACKAGE_HOST_MESON_TOOLS
	help
	  The pg_stat_monitor is a Query Performance Monitoring tool for PostgreSQL.
```

## prototype/package/pg-tiktoken/Config.in
```kconfig
config BR2_PACKAGE_PG_TIKTOKEN
	bool "pg-tiktoken"
	depends on BR2_PACKAGE_HOST_RUSTC_TARGET_ARCH_SUPPORTS
	depends on BR2_PACKAGE_POSTGRESQL
	select HOST_CARGO_PGRX
	select BR2_PACKAGE_HOST_RUSTC
	help
	  Postgres extension that does input tokenization using OpenAI's tiktoken.
```

## prototype/package/pg-uuidv7/Config.in
```kconfig
config BR2_PACKAGE_PG_UUIDV7
	bool "pg-uuidv7"
	depends on BR2_PACKAGE_POSTGRESQL
	help
	  UUIDv7 extension for PostgreSQL (with extended functionality over the native uuidv7() function).
```

## prototype/package/pgexporter/Config.in
```kconfig
config BR2_PACKAGE_PGEXPORTER
	bool "pgexporter"
	depends on BR2_PACKAGE_POSTGRESQL
	select BR2_PACKAGE_LIBEV
	select BR2_PACKAGE_BZIP2
	select BR2_PACKAGE_LZ4
	select BR2_PACKAGE_ZSTD
	help
	  PGExporter for exporting PostgreSQL metrics to Prometheus.
```

## prototype/package/pgmq/Config.in
```kconfig
config BR2_PACKAGE_PGMQ
	bool "pgmq"
	depends on BR2_PACKAGE_POSTGRESQL
	help
	  A lightweight message queue. Like AWS SQS and RSMQ but on Postgres.
```

## prototype/package/pgrouting/Config.in
```kconfig
config BR2_PACKAGE_PGROUTING
	bool "pgrouting"
	depends on BR2_PACKAGE_POSTGRESQL
	select BR2_PACKAGE_BOOST
	help
	  PgRouting extension for PostgreSQL.
```

## prototype/package/pgx-ulid/Config.in
```kconfig
config BR2_PACKAGE_PGX_ULID
	bool "pgx-ulid"
	depends on BR2_PACKAGE_HOST_RUSTC_TARGET_ARCH_SUPPORTS
	depends on BR2_PACKAGE_POSTGRESQL
	select BR2_PACKAGE_HOST_RUSTC
	help
	  A postgres extension to support ulid.
```

## prototype/package/plpgsql-check/Config.in
```kconfig
config BR2_PACKAGE_PLPGSQL_CHECK
	bool "plpgsql-check"
	depends on BR2_PACKAGE_POSTGRESQL
	help
	  PLPGSQL check extension for PostgreSQL.
```

## prototype/package/postgres-exporter/Config.in
```kconfig
config BR2_PACKAGE_POSTGRES_EXPORTER
	bool "postgres-exporter"
	depends on BR2_PACKAGE_POSTGRESQL
    depends on BR2_PACKAGE_HOST_GO_TARGET_ARCH_SUPPORTS
	help
	  Postgres Exporter for exporting PostgreSQL metrics to Prometheus.
```

## prototype/package/postgrest/Config.in
```kconfig
config BR2_PACKAGE_POSTGREST
	bool "postgrest"
	depends on BR2_PACKAGE_POSTGRESQL
	help
	  PostgREST service for PostgreSQL.
```

## prototype/package/rum/Config.in
```kconfig
config BR2_PACKAGE_RUM
	bool "rum"
	depends on BR2_PACKAGE_POSTGRESQL
	help
	  RUM index extension for PostgreSQL.
```

## prototype/package/sb-storage/Config.in
```kconfig
config BR2_PACKAGE_SB_STORAGE
	bool "sb-storage"
	select BR2_PACKAGE_NODEJS_SRC
	select BR2_PACKAGE_HOST_NODEJS
	help
	  This is the Supabase-based storage service.
```
