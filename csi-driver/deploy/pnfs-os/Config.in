## prototype/configs/pnfs_qemu_arm64_defconfig
```kconfig
BR2_aarch64=y
BR2_neoverse_n1=y
BR2_TOOLCHAIN_BUILDROOT_GLIBC=y
BR2_KERNEL_HEADERS_6_12=y
BR2_GCC_VERSION_14_X=y
BR2_TOOLCHAIN_BUILDROOT_CXX=y
BR2_CCACHE=y
BR2_PACKAGE_OVERRIDE_FILE=""
BR2_GLOBAL_PATCH_DIR="$(BR2_EXTERNAL)/boards/common/patches $(BR2_EXTERNAL)/boards/pnfs-common/patches"
BR2_DOWNLOAD_FORCE_CHECK_HASHES=y
BR2_TARGET_GENERIC_HOSTNAME=""
BR2_INIT_SYSTEMD=y
# BR2_TARGET_GENERIC_REMOUNT_ROOTFS_RW is not set
BR2_INIT_SYSTEMD_VAR_FACTORY=y
# BR2_INIT_SYSTEMD_POPULATE_TMPFILES is not set
BR2_SYSTEM_DEFAULT_PATH="/bin:/sbin:/usr/bin:/usr/sbin:/usr/local/bin"
BR2_ENABLE_LOCALE_PURGE=y
BR2_ENABLE_LOCALE_WHITELIST="C en_US"
BR2_GENERATE_LOCALE="en_US.UTF-8"
BR2_ROOTFS_OVERLAY="$(BR2_EXTERNAL)/boards/common/rootfs_overlay $(BR2_EXTERNAL)/boards/pnfs-common/rootfs_overlay"
BR2_ROOTFS_POST_BUILD_SCRIPT="$(BR2_EXTERNAL)/boards/pnfs-common/scripts/post-build.sh"
BR2_ROOTFS_POST_IMAGE_SCRIPT="$(BR2_EXTERNAL)/boards/pnfs-common/scripts/post-image.sh"
BR2_ROOTFS_POST_SCRIPT_ARGS="$(BR2_DEFCONFIG)"
BR2_LINUX_KERNEL=y
BR2_LINUX_KERNEL_CUSTOM_VERSION=y
BR2_LINUX_KERNEL_CUSTOM_VERSION_VALUE="6.18.55"
BR2_LINUX_KERNEL_USE_CUSTOM_CONFIG=y
BR2_LINUX_KERNEL_CUSTOM_CONFIG_FILE="$(BR2_EXTERNAL)/boards/pnfs-qemu-arm64/linux.config"
BR2_LINUX_KERNEL_CONFIG_FRAGMENT_FILES="$(BR2_EXTERNAL)/boards/pnfs-common/linux-pnfs.fragment"
BR2_LINUX_KERNEL_IMAGE=y
BR2_LINUX_KERNEL_NEEDS_HOST_LIBELF=y
BR2_PACKAGE_BUSYBOX_CONFIG="$(BR2_EXTERNAL)/boards/qemu-common/busybox.config"
BR2_PACKAGE_E2FSPROGS=y
BR2_PACKAGE_XFSPROGS=y
BR2_PACKAGE_NVME=y
BR2_PACKAGE_KMOD_TOOLS=y
BR2_PACKAGE_NFS_UTILS=y
BR2_PACKAGE_NFS_UTILS_NFSV4=y
BR2_PACKAGE_NFS_UTILS_RPCDEBUG=y
BR2_PACKAGE_NFS_UTILS_RPC_NFSD=y
BR2_PACKAGE_SYSTEMD_LOGIND=y
# systemd links libcrypto whenever its build finds OpenSSL, and with the prebuilt
# SDK it finds the host's: the guest then boots a systemd whose libcrypto.so.3 is
# not in the image, and init dies. Building OpenSSL for the target puts the one it
# links in the image.
BR2_PACKAGE_OPENSSL=y
BR2_PACKAGE_LIBOPENSSL=y
# BR2_PACKAGE_SYSTEMD_HOSTNAMED is not set
# BR2_PACKAGE_SYSTEMD_HWDB is not set
# BR2_PACKAGE_SYSTEMD_NETWORKD is not set
# BR2_PACKAGE_SYSTEMD_RESOLVED is not set
# BR2_PACKAGE_SYSTEMD_TIMESYNCD is not set
BR2_PACKAGE_UTIL_LINUX_BINARIES=y
BR2_PACKAGE_UTIL_LINUX_MOUNT=y
BR2_PACKAGE_UTIL_LINUX_MOUNTPOINT=y
BR2_TARGET_ROOTFS_EXT2=y
BR2_TARGET_ROOTFS_EXT2_4=y
BR2_TARGET_ROOTFS_EXT2_LABEL="pnfsroot"
BR2_TARGET_ROOTFS_EXT2_SIZE="512M"
# BR2_TARGET_ROOTFS_TAR is not set
BR2_PACKAGE_HOST_QEMU=y
BR2_PACKAGE_HOST_QEMU_SYSTEM_MODE=y
BR2_PACKAGE_DROPBEAR=y
# BR2_PACKAGE_DROPBEAR_CLIENT is not set
```

## prototype/configs/vela_qemu_x64_defconfig
```kconfig
BR2_x86_64=y
BR2_x86_x86_64_v3=y
BR2_TOOLCHAIN_EXTERNAL=y
BR2_TOOLCHAIN_EXTERNAL_CUSTOM=y
BR2_TOOLCHAIN_EXTERNAL_DOWNLOAD=y
BR2_TOOLCHAIN_EXTERNAL_URL="https://install.simplyblock.io/sdk/$(SDK_NAME).tar.gz"
BR2_TOOLCHAIN_EXTERNAL_GCC_14=y
BR2_TOOLCHAIN_EXTERNAL_HEADERS_6_12=y
BR2_TOOLCHAIN_EXTERNAL_CUSTOM_GLIBC=y
# BR2_TOOLCHAIN_EXTERNAL_INET_RPC is not set
BR2_TOOLCHAIN_EXTERNAL_CXX=y
BR2_CCACHE=y
# BR2_STRIP_strip is not set
BR2_PACKAGE_OVERRIDE_FILE=""
BR2_GLOBAL_PATCH_DIR="$(BR2_EXTERNAL)/boards/common/patches $(BR2_EXTERNAL)/boards/qemu-common/patches $(BR2_EXTERNAL)/boards/vela-qemu-x64/patches"
BR2_DOWNLOAD_FORCE_CHECK_HASHES=y
BR2_TARGET_GENERIC_HOSTNAME="db"
BR2_INIT_SYSTEMD=y
BR2_SYSTEM_DHCP="eth0"
BR2_SYSTEM_DEFAULT_PATH="/bin:/sbin:/usr/bin:/usr/sbin:/usr/local/bin"
# BR2_ENABLE_LOCALE_PURGE is not set
BR2_GENERATE_LOCALE="en_US.UTF-8"
BR2_SYSTEM_ENABLE_NLS=y
BR2_ROOTFS_OVERLAY="$(BR2_EXTERNAL)/boards/common/rootfs_overlay $(BR2_EXTERNAL)/boards/qemu-common/rootfs_overlay $(BR2_EXTERNAL)/boards/vela-qemu-x64/rootfs_overlay"
BR2_ROOTFS_POST_BUILD_SCRIPT="$(BR2_EXTERNAL)/boards/vela-qemu-x64/scripts/post-build.sh"
BR2_ROOTFS_POST_IMAGE_SCRIPT="$(BR2_EXTERNAL)/boards/vela-qemu-x64/scripts/post-image.sh"
BR2_ROOTFS_POST_SCRIPT_ARGS="$(BR2_DEFCONFIG)"
BR2_LINUX_KERNEL=y
BR2_LINUX_KERNEL_CUSTOM_VERSION=y
BR2_LINUX_KERNEL_CUSTOM_VERSION_VALUE="6.12.26"
BR2_LINUX_KERNEL_USE_CUSTOM_CONFIG=y
BR2_LINUX_KERNEL_CUSTOM_CONFIG_FILE="$(BR2_EXTERNAL)/boards/vela-qemu-x64/linux.config"
BR2_LINUX_KERNEL_NEEDS_HOST_LIBELF=y
BR2_PACKAGE_BUSYBOX_CONFIG="$(BR2_EXTERNAL)/boards/qemu-common/busybox.config"
BR2_PACKAGE_BZIP2=y
BR2_PACKAGE_ZSTD=y
BR2_PACKAGE_E2FSPROGS_RESIZE2FS=y
BR2_PACKAGE_E2TOOLS=y
BR2_PACKAGE_XFSPROGS=y
BR2_PACKAGE_ACPID=y
BR2_PACKAGE_NODEJS=y
BR2_PACKAGE_LZ4=y
BR2_PACKAGE_LIBPQXX=y
BR2_PACKAGE_POSTGRESQL=y
BR2_PACKAGE_POSTGRESQL_FULL=y
BR2_PACKAGE_POSTGIS=y
BR2_PACKAGE_TIMESCALEDB=y
BR2_PACKAGE_LIBYAML=y
BR2_PACKAGE_LIBCURL_CURL=y
BR2_PACKAGE_LIBCURL_WEBSOCKETS_SUPPORT=y
BR2_PACKAGE_GDAL=y
BR2_PACKAGE_LIBCAP_TOOLS=y
BR2_PACKAGE_LIBCGROUP=y
BR2_PACKAGE_LIBCGROUP_TOOLS=y
BR2_PACKAGE_LIBEV=y
BR2_PACKAGE_LINUX_PAM=y
BR2_PACKAGE_PROTOBUF=y
BR2_PACKAGE_ICU=y
BR2_PACKAGE_PCRE2=y
BR2_PACKAGE_PCRE2_16=y
BR2_PACKAGE_PCRE2_32=y
BR2_PACKAGE_CHRONY=y
BR2_PACKAGE_OPENSSH=y
# BR2_PACKAGE_OPENSSH_CLIENT is not set
BR2_PACKAGE_FILE=y
BR2_PACKAGE_LOCKFILE_PROGS=y
BR2_PACKAGE_UTIL_LINUX_BINARIES=y
BR2_TARGET_ROOTFS_EXT2=y
BR2_TARGET_ROOTFS_EXT2_4=y
BR2_TARGET_ROOTFS_EXT2_LABEL="vmroot"
BR2_TARGET_ROOTFS_EXT2_SIZE="2G"
# BR2_TARGET_ROOTFS_TAR is not set
BR2_PACKAGE_HOST_GO=y
BR2_PACKAGE_HOST_QEMU_SYSTEM_MODE=y
BR2_PACKAGE_HOST_QEMU_VIRTFS=y
BR2_PACKAGE_PGVECTOR=y
BR2_PACKAGE_SU_EXEC=y
BR2_PACKAGE_VM_MONITOR=y
BR2_PACKAGE_NEONVMD=y
BR2_PACKAGE_PGBOUNCER=y
BR2_PACKAGE_VECTOR=y
BR2_PACKAGE_SB_STORAGE=y
BR2_PACKAGE_PG_META=y
BR2_PACKAGE_PGROUTING=y
BR2_PACKAGE_H3=y
BR2_PACKAGE_POSTGRESQL_UNIT=y
BR2_PACKAGE_HYPOPG=y
BR2_PACKAGE_HASHIDS=y
BR2_PACKAGE_RUM=y
BR2_PACKAGE_PGTAP=y
BR2_PACKAGE_IP4R=y
BR2_PACKAGE_PREFIX=y
BR2_PACKAGE_POSTGRESQL_HLL=y
BR2_PACKAGE_PG_IVM=y
BR2_PACKAGE_PG_CRON=y
BR2_PACKAGE_PLPGSQL_CHECK=y
BR2_PACKAGE_PG_HINT_PLAN=y
BR2_PACKAGE_PG_UUIDV7=y
BR2_PACKAGE_PG_NET=y
BR2_PACKAGE_PG_JWT=y
BR2_PACKAGE_PG_REPACK=y
BR2_PACKAGE_PGSQL_HTTP=y
BR2_PACKAGE_PGMQ=y
BR2_PACKAGE_PG_PARTMAN=y
BR2_PACKAGE_PG_ROARINGBITMAP=y
BR2_PACKAGE_PG_GRAPHQL=y
BR2_PACKAGE_PGSODIUM=y
BR2_PACKAGE_PG_AUDIT=y
BR2_PACKAGE_PG_DUCKDB=y
BR2_PACKAGE_PGAUDITLOGTOFILE=y
BR2_PACKAGE_SUPABASE_VAULT=y
BR2_PACKAGE_WAL2JSON=y
BR2_PACKAGE_PG_JSONSCHEMA=y
BR2_PACKAGE_POSTGRESQL_ANONYMIZER=y
BR2_PACKAGE_PGX_ULID=y
BR2_PACKAGE_POSTGREST=y
BR2_PACKAGE_DBMATE=y
BR2_PACKAGE_POSTGRES_EXPORTER=y
BR2_PACKAGE_PGBOUNCER_EXPORTER=y
BR2_PACKAGE_TIMESCALEDB_TUNE=y
BR2_PACKAGE_SYSTEMD_EXPORTER=y
BR2_PACKAGE_APACHE_AGE=y
```
