## prototype/package/supabase-vault/Config.in
```kconfig
config BR2_PACKAGE_SUPABASE_VAULT
	bool "supabase-vault"
	depends on BR2_PACKAGE_POSTGRESQL
	select BR2_PACKAGE_LIBSODIUM
	select BR2_PACKAGE_LIBSODIUM_FULL
	help
	  PostgreSQL extension for storing encrypted secrets in the Vault.
```

## prototype/package/timescaledb-tune/Config.in
```kconfig
config BR2_PACKAGE_TIMESCALEDB_TUNE
	bool "timescaledb-tune"
	depends on BR2_PACKAGE_HOST_GO_TARGET_ARCH_SUPPORTS
	select BR2_PACKAGE_TIMESCALEDB
	help
	  timescaledb-tune automatically tunes PostgreSQL configuration
	  based on system resources.
```

## prototype/package/vm-monitor/Config.in
```kconfig
config BR2_PACKAGE_VM_MONITOR
	bool "vm-monitor"
	depends on BR2_PACKAGE_HOST_RUSTC_TARGET_ARCH_SUPPORTS
	select BR2_PACKAGE_HOST_RUSTC
	help
	  The Neon VM Monitor.
```

## prototype/package/wal2json/Config.in
```kconfig
config BR2_PACKAGE_WAL2JSON
	bool "wal2json"
	depends on BR2_PACKAGE_POSTGRESQL
	help
	  JSON output plugin for changeset extraction using PostgreSQL logical decoding.
```
